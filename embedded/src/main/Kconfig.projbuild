## embedded/src/main/Kconfig.projbuild
```kconfig
menu "APD ESP32 Offline Chat"

config APP_NODE_ID
    int "Node numeric ID"
    range 1 254
    default 1
    help
        Unique sender ID carried in every application packet.

config APP_NODE_NAME
    string "Node display name"
    default "NODE_A"

config APP_AP_SSID
    string "SoftAP Wi-Fi SSID"
    default "APD-Node-A"

config APP_AP_PASSWORD
    string "SoftAP Wi-Fi Password (empty = open)"
    default ""

config ESPNOW_CHANNEL
    int "ESP-NOW & SoftAP Wi-Fi channel"
    range 1 13
    default 6
    help
        Both SoftAP and ESP-NOW operate on this fixed channel.

config CHAT_ACK_TIMEOUT_MS
    int "Chat ACK timeout (ms)"
    range 50 5000
    default 400

config CHAT_MAX_RETRIES
    int "Chat maximum retries"
    range 1 20
    default 4

endmenu
```

## sdkconfig.defaults
```kconfig
CONFIG_PARTITION_TABLE_CUSTOM=y
CONFIG_PARTITION_TABLE_CUSTOM_FILENAME="partitions.csv"
CONFIG_ESP_MAIN_TASK_STACK_SIZE=8192
CONFIG_FREERTOS_HZ=1000
CONFIG_ESPTOOLPY_FLASHSIZE_4MB=y
CONFIG_ESPTOOLPY_FLASHSIZE="4MB"
CONFIG_HTTPD_WS_SUPPORT=y
CONFIG_HTTPD_MAX_REQ_HDR_LEN=1024
CONFIG_HTTPD_MAX_URI_LEN=512
CONFIG_SPIFFS_MAX_PARTITIONS=3
CONFIG_LWIP_MAX_SOCKETS=16
CONFIG_LWIP_SO_REUSE=y
```
